## meta-thalasso/conf/distro/thalasso.conf
```bitbake
DISTRO = "thalasso"
DISTRO_NAME = "Thalasso - ThalesOs By Thales Alenia Space"
DISTRO_VERSION = "0.1.0"
DISTRO_CODENAME = "Lunar SkyDiver"


PREFERRED_PROVIDER_virtual/kernel = "linux-thalasso"
PREFERRED_VERSION_linux-thalasso ?= "4.1.18+xenomai"

LOCALCONF_VERSION = "1"

DISTRO_VERSION[vardepsexclude] = "DATE"
THALASSO_DEFAULT_DISTRO_FEATURES = "largefile opengl ptest multiarch wayland"
THALASSO_DEFAULT_EXTRA_RDEPENDS = "packagegroup-core-boot"
THALASSO_DEFAULT_EXTRA_RRECOMMENDS = "kernel-module-af-packet"

DISTRO_FEATURES ?= "${DISTRO_FEATURES_DEFAULT} ${DISTRO_FEATURES_LIBC} ${THALASSO_DEFAULT_DISTRO_FEATURES}"

DISTRO_EXTRA_RDEPENDS += " ${THALASSO_DEFAULT_EXTRA_RDEPENDS}"
DISTRO_EXTRA_RRECOMMENDS += " ${THALASSO_DEFAULT_EXTRA_RRECOMMENDS}"

THALASSOQEMUDEPS = "${@bb.utils.contains("INCOMPATIBLE_LICENSE", "GPL-3.0", "", "packagegroup-core-device-devel",d)}"
DISTRO_EXTRA_RDEPENDS_append_qemuarm = " ${THALASSOQEMUDEPS}"
DISTRO_EXTRA_RDEPENDS_append_qemuarm64 = " ${THALASSOQEMUDEPS}"
DISTRO_EXTRA_RDEPENDS_append_qemumips = " ${THALASSOQEMUDEPS}"
DISTRO_EXTRA_RDEPENDS_append_qemuppc = " ${THALASSOQEMUDEPS}"
DISTRO_EXTRA_RDEPENDS_append_qemux86 = " ${THALASSOQEMUDEPS}"
DISTRO_EXTRA_RDEPENDS_append_qemux86-64 = " ${THALASSOQEMUDEPS}"

require conf/distro/include/poky-world-exclude.inc
require conf/distro/include/no-static-libs.inc
require conf/distro/include/yocto-uninative.inc
INHERIT += "uninative"
```

## meta-thalasso/conf/layer.conf
```bitbake
# We have a conf and classes directory, add to BBPATH
BBPATH .= ":${LAYERDIR}"

# We have recipes-* directories, add to BBFILES
BBFILES += "${LAYERDIR}/recipes-*/*/*.bb \
	${LAYERDIR}/recipes-*/*/*.bbappend"

BBFILE_COLLECTIONS += "thalasso"
BBFILE_PATTERN_thalasso = "^${LAYERDIR}/"
BBFILE_PRIORITY_thalasso = "6"
```
